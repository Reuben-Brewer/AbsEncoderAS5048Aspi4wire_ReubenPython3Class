/*
Reuben Brewer, Ph.D.
reuben.brewer@gmail.com
www.reubotics.com

Apache 2 License
Software Revision D, 10/27/2024

Verified working on: Teensy 3.2 and Teensy 4.1

///
SPI0_0, Teensy 3.2/4.1 
AS5048A:        GND   MISO   MOSI   SCK   CS    PWM   3.3V   5V    //(In physical order left-->right on AS5048A-EK-AB-STM1.1-ND EVAL board)
Teensy 3.2/4.1  GND   12     11     13    10    NC    3.3V   NC    //3.3V works great for powering the AS5048A.
///

///
SPI1_0, Teensy 4.1 
AS5048A:        GND   MISO   MOSI   SCK   CS    PWM   3.3V   5V    //(In physical order left-->right on AS5048A-EK-AB-STM1.1-ND EVAL board)
Teensy 4.1      GND   1      26     27    0     NC    3.3V   NC    //3.3V works great for powering the AS5048A.
///

///
FTDI_USBtoSerialCable_3MBaudMax_TTL-232RG-VREG3V3-WE: Tx = Orange, Rx = Yellow, GND = Black, 3.3V = Red

Serial1, Teensy 4.1:    Rx1: 0,    Tx1: 1
Serial1, Teensy 3.2:    Rx1: 0,    Tx1: 1

Serial2, Teensy 4.1:    Rx2: 7,    Tx2: 8
Serial2, Teensy 3.2:    Rx2: 9,    Tx2: 10

Serial3, Teensy 4.1:    Rx3: 15,   Tx3: 14
Serial3, Teensy 3.2:    Rx3: 7,   Tx3: 8
///

Tx = Orange
Rx = Yellow

*/

////////////////////////////////////////////////////////////////////////////////////////////////////
////////////////////////////////////////////////////////////////////////////////////////////////////
#include <SPI.h> //https://forum.pjrc.com/index.php?threads/teensy-4-1-spi-slave-here-it-is.72792/  : "just SPI master is supported"  https://arduino.stackexchange.com/questions/76528/spi-slave-programming-for-arduino
#include <ArduinoJson.h>


//C:\Users\reube\AppData\Local\Arduino15\packages\teensy\hardware\avr\1.59.0\cores\teensy4

/*
from arduino.h

#define PI 3.1415926535897932384626433832795
#define HALF_PI 1.5707963267948966192313216916398
#define TWO_PI 6.283185307179586476925286766559
#define DEG_TO_RAD 0.017453292519943295769236907684886
#define RAD_TO_DEG 57.295779513082320876798154814105
*/

/*
https://www.pjrc.com/teensy/td_uart.html
The most common issue with serial ports on Teensy is use of code designed for Arduino Uno with Serial within the code. 
On Teensy, Serial accesses the USB only. 
USB and Serial1 (pins 0 & 1) are not shared on Teensy. 
For hardware serial ports, Serial1, Serial2, Serial3, Serial4, Serial5, Serial6, Serial7 or Serial8 must be used. 
*/
////////////////////////////////////////////////////////////////////////////////////////////////////
////////////////////////////////////////////////////////////////////////////////////////////////////

//////////////////////////////////////////////////////////////////////////////////////////////////// Function Declarations
//////////////////////////////////////////////////////////////////////////////////////////////////// Only a function declaration can have a default parameter value, not the definition.
void InitializeDebuggingSerial();
void SendStringOverDebuggingSerialImmediately(String StringToSend);

void InitializeHardwareSerial2();
void SendStringOverHardwareSerial2Immediately(String StringToSend);

void InitializeDebuggingLED();
void SetStateOnDebuggingLED(int LEDstate_ToBeSet, int SendSerialDebuggingFlag=0);
void ToggleStateOnDebuggingLED(int SendSerialDebuggingFlag=0);

void InitializeSPI_AS5048A();
void ReadSPI_AS5048A(int SendSerialDebuggingFlag);

void InitializeAnalogInputs();
void ReadAnalogInputs(int SendSerialDebuggingFlag=0);

double SinusoidalInput_UpdateValue(double MagnitudeOfRandomNoiseToAdd=0.0);

void InitializeJSON();
void SendJSONmessageOverSomeSerial(int SerialPortNumber=0);

double ConvertDoubleToNumberOfDecimalPlaces(double InputNumber, int NumberOfDecimalPlaces);
////////////////////////////////////////////////////////////////////////////////////////////////////
////////////////////////////////////////////////////////////////////////////////////////////////////

////////////////////////////////////////////////////////////////////////////////////////////////////
////////////////////////////////////////////////////////////////////////////////////////////////////
#define SPI_CS_0_0  10 //software or hardware SPI
#define SPI_MOSI_0  11 //hardware SPI
#define SPI_MISO_0  12 //hardware SPI
#define SPI_CLK_0  13 //hardware SPI

#define SPI_CS_1_0  0 //software or hardware SPI
#define SPI_MOSI_1  26 //hardware SPI
#define SPI_MISO_1  1 //hardware SPI
#define SPI_CLK_1  27 //hardware SPI

#define HardwareSerial2_BaudRate 2000000//Max 2000000 for non-Teensy, fast Arduino boards, also for Teensy 4.1 HardwareSerial2 with FTDI TTL-232RG-VREG3V3-WE (even though the spec. sheet says 3MBaus is the max)

#define SERIAL_TX_BUFFER_SIZE 1 //DOESN'T APPEAR TO BE WORKING
#define SERIAL_RX_BUFFER_SIZE 64 //DOESN'T APPEAR TO BE WORKING

#define SinusoidalInput_HalfPeriodInSeconds 2.0
#define SinusoidalInput_MinValue -20.0
#define SinusoidalInput_MaxValue 20.0
////////////////////////////////////////////////////////////////////////////////////////////////////
////////////////////////////////////////////////////////////////////////////////////////////////////

////////////////////////////////////////////////////////////////////////////////////////////////////
////////////////////////////////////////////////////////////////////////////////////////////////////
const double LoopFrequencyHz = 400.0; //400Hz works great for only Time, DebugVar (~42 Bytes/message). //150Hz works great for Time, AngleFloatDegrees, AnalogSensor_Value_AO0, DebugVar (~102 Bytes/message)

const int SPI_ChannelNumber0or1 = 1;

const int LEDpin = LED_BUILTIN;  // the number of the BuiltIn (orange) LED pin //#define LED_BUILTIN   (13), conflicts with SPI0 SCK0 - PIN 13 
unsigned int LEDstate = 0;  // LEDstate used to set the BuiltIn (orange) LED

unsigned long CurrentTimeInMilliseconds = millis();
unsigned long LastTimeInMilliseconds = millis();

const int AnalogSensor_Pin_AO0 = A0;
int AnalogSensor_Value_AO0 = 0;

uint8_t AngleByte_MSB;
uint8_t AngleByte_LSB;
uint16_t AngleInt;
double AngleFloatDegrees;

double SinusoidalInput_CalculatedValue = 0.0;

double DebugVar = 0.0;

SPISettings SPI0and1_Settings(10000000, MSBFIRST, SPI_MODE1); //SPI_MODE1 is specified in the AS5048A datasheet as "Wire_mode = 1". Speed = 1953000 works, as does 10000000.

bool DebuggingSerialConnectedFlag = 0;
bool HardwareSerial2ConnectedFlag = 0;

JsonDocument JSONdoc; //Allocate the JSON document. To make a variable global, just declare it outside of any function, preferably before the setup function.
////////////////////////////////////////////////////////////////////////////////////////////////////
////////////////////////////////////////////////////////////////////////////////////////////////////

////////////////////////////////////////////////////////////////////////////////////////////////////
////////////////////////////////////////////////////////////////////////////////////////////////////
double ConvertDoubleToNumberOfDecimalPlaces(double InputNumber, int NumberOfDecimalPlaces)
{
  double PowerNumber = pow(10, NumberOfDecimalPlaces);
  double OutputNumber = round(InputNumber*PowerNumber)/PowerNumber;

  return OutputNumber;
}
////////////////////////////////////////////////////////////////////////////////////////////////////
////////////////////////////////////////////////////////////////////////////////////////////////////

////////////////////////////////////////////////////////////////////////////////////////////////////
////////////////////////////////////////////////////////////////////////////////////////////////////
double SinusoidalInput_UpdateValue(double MagnitudeOfRandomNoiseToAdd)
{
  double RandomNoise = MagnitudeOfRandomNoiseToAdd*random(0, 1000)/1000.0;

  double SinusoidalInput_TimeGain = PI/(2.0 * SinusoidalInput_HalfPeriodInSeconds);
  SinusoidalInput_CalculatedValue = RandomNoise + (SinusoidalInput_MaxValue + SinusoidalInput_MinValue)/2.0 + 0.5*abs(SinusoidalInput_MaxValue - SinusoidalInput_MinValue)*sin(SinusoidalInput_TimeGain*CurrentTimeInMilliseconds/1000.0);

  return SinusoidalInput_CalculatedValue;
}
////////////////////////////////////////////////////////////////////////////////////////////////////
////////////////////////////////////////////////////////////////////////////////////////////////////

////////////////////////////////////////////////////////////////////////////////////////////////////
////////////////////////////////////////////////////////////////////////////////////////////////////
void InitializeSPI_AS5048A()
{

  /*
  //Alternative method to using the "SPI0_Settings" method. SEEMS TO RESULT IN BAD DATA.
  SPI.setBitOrder(MSBFIRST);
  SPI.setDataMode(SPI_MODE1);
  SPI.setClockDivider(SPI_CLOCK_DIV32);
  */

  if(SPI_ChannelNumber0or1 == 0)
  {
    pinMode(SPI_CS_0_0, OUTPUT);

    //SPI.setCS(SPI_CS0_0); //THIS LINE RESULTS IN RECEIVING ALL 0XFF VALUES, NOT SURE WHY. THE OTHER SPI.setPINS FUNCTIONS WORK.
    SPI.setMOSI(SPI_MOSI_0);
    SPI.setMISO(SPI_MISO_0);
    SPI.setSCK(SPI_CLK_0);

    SPI.begin();
  }
  else if(SPI_ChannelNumber0or1 == 1)
  {
    pinMode(SPI_CS_1_0, OUTPUT);

    ///*
    //SPI1.setCS(SPI_CS_1_0); //THIS LINE RESULTS IN RECEIVING ALL 0XFF VALUES, NOT SURE WHY. THE OTHER SPI.setPINS FUNCTIONS WORK.
    SPI1.setMOSI(SPI_MOSI_1);
    SPI1.setMISO(SPI_MISO_1);
    SPI1.setSCK(SPI_CLK_1);
    
    SPI1.begin(); //NOTE THAT THIS IS A DIFFERENT OBJECT ("SPI1.") INSTEAD OF "SPI."!
  }

}
////////////////////////////////////////////////////////////////////////////////////////////////////
////////////////////////////////////////////////////////////////////////////////////////////////////

////////////////////////////////////////////////////////////////////////////////////////////////////
////////////////////////////////////////////////////////////////////////////////////////////////////
void ReadSPI_AS5048A(int SendSerialDebuggingFlag)
{

    ////////////////////////////////////////////////////////////////////////////////////////////////////
    if(SPI_ChannelNumber0or1 == 0)
    {
      SPI.beginTransaction(SPI0and1_Settings);

      digitalWriteFast(SPI_CS_0_0, LOW);

      AngleByte_MSB = SPI.transfer(0xFF); //AS5048A requires an 0xFFFF to be sent to get the last anglular value. Non-blocking.
      AngleByte_LSB = SPI.transfer(0xFF); //Non-blocking.
    }
    else if(SPI_ChannelNumber0or1 == 1)
    {
      SPI1.beginTransaction(SPI0and1_Settings);

      digitalWriteFast(SPI_CS_1_0, LOW);

      AngleByte_MSB = SPI1.transfer(0xFF); //AS5048A requires an 0xFFFF to be sent to get the last anglular value. Non-blocking.
      AngleByte_LSB = SPI1.transfer(0xFF); //Non-blocking.
    }
    ////////////////////////////////////////////////////////////////////////////////////////////////////

    ////////////////////////////////////////////////////////////////////////////////////////////////////
    AngleInt = 1.0*( ( (AngleByte_MSB & 0b00111111) << 8) | (AngleByte_LSB & 0b11111111) );  //0x3F = 0b00111111, & 0x3FFF.
    AngleFloatDegrees = 360.0 * (AngleInt / 16383.0);  //0x3FFF = 16383 = 2^14-1 = max value
    ////////////////////////////////////////////////////////////////////////////////////////////////////

    ////////////////////////////////////////////////////////////////////////////////////////////////////
    if(SPI_ChannelNumber0or1 == 0)
    {
      digitalWriteFast(SPI_CS_0_0, HIGH);
      SPI.endTransaction();
    }
    else if(SPI_ChannelNumber0or1 == 1)
    {
      digitalWriteFast(SPI_CS_1_0, HIGH);
      SPI1.endTransaction();
    }
    ////////////////////////////////////////////////////////////////////////////////////////////////////

    ////////////////////////////////////////////////////////////////////////////////////////////////////
    if(SendSerialDebuggingFlag == 1)
    {
      if(HardwareSerial2ConnectedFlag == 1)
      {
        Serial.println("ReadSPI: MSB: " + String(AngleByte_MSB) + ", LSB: " + String(AngleByte_LSB) + ", AngleInt: " + String(AngleInt) + ", AngleFloat: " + String(AngleFloatDegrees));
      }
    }
    ////////////////////////////////////////////////////////////////////////////////////////////////////

}
////////////////////////////////////////////////////////////////////////////////////////////////////
////////////////////////////////////////////////////////////////////////////////////////////////////

////////////////////////////////////////////////////////////////////////////////////////////////////
////////////////////////////////////////////////////////////////////////////////////////////////////
void InitializeDebuggingLED()
{
  if(SPI_ChannelNumber0or1 != 0) //Because the SPI0_0 pin SPI_CLK_0 = 13 = LED_BUILTIN
  {
    pinMode(LEDpin, OUTPUT); // set the digital pin as output:
    SetStateOnDebuggingLED(LEDstate, 0);
  }
}
////////////////////////////////////////////////////////////////////////////////////////////////////
////////////////////////////////////////////////////////////////////////////////////////////////////

////////////////////////////////////////////////////////////////////////////////////////////////////
////////////////////////////////////////////////////////////////////////////////////////////////////
void SetStateOnDebuggingLED(int LEDstate_ToBeSet, int SendSerialDebuggingFlag)
{
  ////////////////////////////////////////////////////////////////////////////////////////////////////
  if(SPI_ChannelNumber0or1 != 0) //Because the SPI0_0 pin SPI_CLK_0 = 13 = LED_BUILTIN
  {
    LEDstate = LEDstate_ToBeSet;
    digitalWrite(LEDpin, LEDstate);
  }
  ////////////////////////////////////////////////////////////////////////////////////////////////////

  ////////////////////////////////////////////////////////////////////////////////////////////////////
  if(SendSerialDebuggingFlag == 1)
  {
      if(HardwareSerial2ConnectedFlag == 1)
      {
        Serial.println("SetStateOnDebuggingLED event fired, LEDstate_ToBeSet = " + String(LEDstate)); //println vs 2 .writes
      }
  }
  ////////////////////////////////////////////////////////////////////////////////////////////////////
}
////////////////////////////////////////////////////////////////////////////////////////////////////
////////////////////////////////////////////////////////////////////////////////////////////////////

////////////////////////////////////////////////////////////////////////////////////////////////////
////////////////////////////////////////////////////////////////////////////////////////////////////
void ToggleStateOnDebuggingLED(int SendSerialDebuggingFlag)
{
  if (LEDstate == 0)
  {
    SetStateOnDebuggingLED(1, SendSerialDebuggingFlag);
  }
  else
  {
    SetStateOnDebuggingLED(0, SendSerialDebuggingFlag);
  }
}
////////////////////////////////////////////////////////////////////////////////////////////////////
////////////////////////////////////////////////////////////////////////////////////////////////////

////////////////////////////////////////////////////////////////////////////////////////////////////
////////////////////////////////////////////////////////////////////////////////////////////////////
void InitializeJSON()
{
  //Nothing needed other than the above line:
  //JsonDocument JSONdoc; //Allocate the JSON document. To make a variable global, just declare it outside of any function, preferably before the setup function.
}
////////////////////////////////////////////////////////////////////////////////////////////////////
////////////////////////////////////////////////////////////////////////////////////////////////////

////////////////////////////////////////////////////////////////////////////////////////////////////
////////////////////////////////////////////////////////////////////////////////////////////////////
void SendJSONmessageOverSomeSerial(int SerialPortNumber)
{

  JSONdoc["Time"] = CurrentTimeInMilliseconds/1000.0;
  //JSONdoc["AngleFloatDegrees"] = AngleFloatDegrees;
  //JSONdoc["AnalogSensor_Value_AO0"] = AnalogSensor_Value_AO0;

  double DebugVar_SmallerNumberOfDecimalPlaces = ConvertDoubleToNumberOfDecimalPlaces(DebugVar, 1);

  JSONdoc["DebugVar"] = DebugVar_SmallerNumberOfDecimalPlaces;

  String StringToSend = "";
  serializeJson(JSONdoc, StringToSend); 

  if(SerialPortNumber == 0)
  {
    StringToSend = StringToSend + "\r\n";
    SendStringOverDebuggingSerialImmediately(StringToSend);
    //Serial.println(StringToSend); //Automatically adds "\r\n" to String
  }
  else if(SerialPortNumber == 2)
  {
    StringToSend = StringToSend + "\r\n";
    SendStringOverHardwareSerial2Immediately(StringToSend);
    
    //Serial2.println(StringToSend); //Automatically adds "\r\n" to String
  }
 
}
////////////////////////////////////////////////////////////////////////////////////////////////////
////////////////////////////////////////////////////////////////////////////////////////////////////

////////////////////////////////////////////////////////////////////////////////////////////////////
////////////////////////////////////////////////////////////////////////////////////////////////////
void InitializeDebuggingSerial()
{
    /*
    Needed for native USB port only. optional on Teensy. 
    USB hardware initialization is performed before setup() runs. 
    The baud rate input is ignored, and only used for Arduino compatibility.
    USB serial communication always occurs at full USB speed.

    Serial.begin(9600);
    while (!Serial) 
    {
      ;  // wait for serial port to connect. 
    }
    */

    DebuggingSerialConnectedFlag = 1;
      
}
////////////////////////////////////////////////////////////////////////////////////////////////////
////////////////////////////////////////////////////////////////////////////////////////////////////

////////////////////////////////////////////////////////////////////////////////////////////////////
////////////////////////////////////////////////////////////////////////////////////////////////////
void SendStringOverDebuggingSerialImmediately(String StringToSend)
{

  /* Serial.write() can write individual bytes or arrays of bytes (like character arrays).
    Serial.print() converts ints, floats, etc. to strings and calls Serial.write() to send the string. */

  /* //Also works
  for (unsigned int i = 0; i < StringToSend.length(); i++)
  {
    Serial.write(StringToSend[i]);   // Push each char 1 by 1 on each loop pass
  }
  */

  Serial.write(StringToSend.c_str());
  Serial.send_now(); //Transmit any buffered data as soon as possible
}
////////////////////////////////////////////////////////////////////////////////////////////////////
////////////////////////////////////////////////////////////////////////////////////////////////////

////////////////////////////////////////////////////////////////////////////////////////////////////
////////////////////////////////////////////////////////////////////////////////////////////////////
void InitializeHardwareSerial2()
{

    Serial2.begin(HardwareSerial2_BaudRate);
    while (!Serial2) 
    {
      ;  // wait for serial port to connect. 
    }

    HardwareSerial2ConnectedFlag = 1;
      
}
////////////////////////////////////////////////////////////////////////////////////////////////////
////////////////////////////////////////////////////////////////////////////////////////////////////

////////////////////////////////////////////////////////////////////////////////////////////////////
////////////////////////////////////////////////////////////////////////////////////////////////////
void SendStringOverHardwareSerial2Immediately(String StringToSend)
{
  Serial2.write(StringToSend.c_str());
  Serial2.flush(); //Improves the latency.
}
////////////////////////////////////////////////////////////////////////////////////////////////////
////////////////////////////////////////////////////////////////////////////////////////////////////

////////////////////////////////////////////////////////////////////////////////////////////////////
////////////////////////////////////////////////////////////////////////////////////////////////////
void InitializeAnalogInputs()
{
  //Nothing required to setup analog inputs.
}
////////////////////////////////////////////////////////////////////////////////////////////////////
////////////////////////////////////////////////////////////////////////////////////////////////////

////////////////////////////////////////////////////////////////////////////////////////////////////
////////////////////////////////////////////////////////////////////////////////////////////////////
void ReadAnalogInputs(int SendSerialDebuggingFlag)
{
  AnalogSensor_Value_AO0 = analogRead(AnalogSensor_Pin_AO0);

  if(SendSerialDebuggingFlag == 1)
  {
      if(HardwareSerial2ConnectedFlag == 1)
      {
        Serial.println("AO0 = " + String(AnalogSensor_Value_AO0)); //println vs 2 .writes
      }
  }
}
////////////////////////////////////////////////////////////////////////////////////////////////////
////////////////////////////////////////////////////////////////////////////////////////////////////

////////////////////////////////////////////////////////////////////////////////////////////////////
////////////////////////////////////////////////////////////////////////////////////////////////////
void setup() 
{
  InitializeDebuggingSerial();
  InitializeHardwareSerial2();
  delay(250); //Need to wait for serial to be initialized before we call other functions where serial debugging is required.

  InitializeDebuggingLED();

  InitializeSPI_AS5048A();

  InitializeAnalogInputs();

  InitializeJSON();
}
////////////////////////////////////////////////////////////////////////////////////////////////////
////////////////////////////////////////////////////////////////////////////////////////////////////

////////////////////////////////////////////////////////////////////////////////////////////////////
////////////////////////////////////////////////////////////////////////////////////////////////////
void loop() 
{

  CurrentTimeInMilliseconds = millis();
  
  double LoopDeltaTinMilliseconds = (1.0/LoopFrequencyHz)*1000.0;

  if (CurrentTimeInMilliseconds - LastTimeInMilliseconds >= LoopDeltaTinMilliseconds) 
  {
    ////////////////////////////////////////////////////////////////////////////////////////////////////
    
    ReadSPI_AS5048A(0); //SendSerialDebuggingFlag=1
    ReadAnalogInputs(0); //SendSerialDebuggingFlag=1
    
    //DebugVar = SinusoidalInput_UpdateValue(1.0); //double MagnitudeOfRandomNoiseToAdd=0.0
    DebugVar = AngleFloatDegrees;

    SendJSONmessageOverSomeSerial(2); //void SendJSONmessageOverSomeSerial(int SerialPortNumber)

    //ToggleStateOnDebuggingLED(1); //SendSerialDebuggingFlag=1
    LastTimeInMilliseconds = CurrentTimeInMilliseconds;
    ////////////////////////////////////////////////////////////////////////////////////////////////////
  }

}
////////////////////////////////////////////////////////////////////////////////////////////////////
////////////////////////////////////////////////////////////////////////////////////////////////////
